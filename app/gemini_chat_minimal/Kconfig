## app/gemini_chat_minimal/Kconfig
```kconfig
config GEMINI_CHAT_MINIMAL
	bool "Gemini-S1 minimal screen and voice chat"
	default n
	depends on GRAPHICS_LVGL && EXAMPLES_AI_AGENT_VELA
	depends on LV_USE_NUTTX_LCD && MEDIA_SERVER
	select LV_FONT_SIMSUN_16_CJK
```
